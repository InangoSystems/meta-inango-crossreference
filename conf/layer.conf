## conf/layer.conf
```bitbake
# Copyright (C) 2019 Inango Systems Ltd
# Released under the ******  license (see COPYING.INANGO for the terms)

# We have a conf and classes directory, add to BBPATH
BBPATH .= ":${LAYERDIR}"

# We have recipes-* directories, add to BBFILES
BBFILES += "${LAYERDIR}/recipes-*/*/*.bb \
	${LAYERDIR}/recipes-*/*/*.bbappend"

BBFILE_COLLECTIONS += "inango"
BBFILE_PATTERN_inango = "^${LAYERDIR}/"
BBFILE_PRIORITY_inango = "6"

INHERIT += "cross-reference"
IMAGE_CLASSES += "image-cross-reference"
INHERIT += "patchall"
```
